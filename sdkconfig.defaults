## sdkconfig.defaults
```kconfig
CONFIG_ESPTOOLPY_FLASHMODE_QIO=y
CONFIG_ESPTOOLPY_FLASHFREQ_80M=y
CONFIG_ESPTOOLPY_FLASHSIZE_4MB=y
CONFIG_PARTITION_TABLE_CUSTOM=y
CONFIG_ESP32_DEFAULT_CPU_FREQ_240=y
CONFIG_ESP32_DEFAULT_CPU_FREQ_MHZ=240
CONFIG_FROGFS_LOG_LEVEL_DEBUG=y
CONFIG_FROGFS_USE_HEATSHRINK=y
CONFIG_CWHTTPD_LOG_LEVEL_DEBUG=y
CONFIG_CWHTTPD_MBEDTLS=y
CONFIG_FATFS_LFN_HEAP=y
```
